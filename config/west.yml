## config/west.yml
```yaml
manifest:
  remotes:
    - name: zmkfirmware
      url-base: https://github.com/zmkfirmware
    - name: osleg
      url-base: https://github.com/osleg/
  projects:
    # - name: zmk
    #   remote: osleg
    #   revision: encoders
    #   import: app/west.yml
    - name: zmk
      remote: zmkfirmware
      revision: main
      import: app/west.yml
  self:
    path: config
```
